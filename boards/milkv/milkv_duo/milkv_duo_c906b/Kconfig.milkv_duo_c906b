## boards/milkv/milkv_duo/milkv_duo_c906b/Kconfig.milkv_duo_c906b
```kconfig
# Copyright (c) 2023 ZHOU Kejun <zhoukejun@outlook.com>
# SPDX-License-Identifier: Apache-2.0

config BOARD_MILKV_DUO_C906B
	select SOC_CV1800B_C906B
```

## boards/milkv/milkv_duo/milkv_duo_c906l/Kconfig.milkv_duo_c906l
```kconfig
# Copyright (c) 2024 Kejun Zhou <zhoukejun@outlook.com>
# SPDX-License-Identifier: Apache-2.0

config BOARD_MILKV_DUO_C906L
	select SOC_CV1800B_C906L
```

## boards/milkv/milkv_duo256m/milkv_duo256m_c906l/Kconfig.milkv_duo256m_c906l
```kconfig
# Copyright (c) 2023 ZHOU Kejun <zhoukejun@outlook.com>
# SPDX-License-Identifier: Apache-2.0

config BOARD_MILKV_DUO256M_C906L
	select SOC_SG2002_C906L
```

## dts/bindings/cpu/thead,c906b.yaml
```yaml
# SPDX-License-Identifier: Apache-2.0

description: T-Head C906B RISC-V CPU

compatible: "thead,c906b"

include: riscv,cpus.yaml
```

## dts/bindings/cpu/thead,c906l.yaml
```yaml
# SPDX-License-Identifier: Apache-2.0

description: T-Head C906L RISC-V CPU

compatible: "thead,c906l"

include: riscv,cpus.yaml
```
